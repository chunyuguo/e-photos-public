## sdkconfig.defaults
```kconfig
CONFIG_ESPTOOLPY_FLASHSIZE_16MB=y
CONFIG_ESPTOOLPY_FLASHMODE_QIO=y
CONFIG_PARTITION_TABLE_CUSTOM=y
CONFIG_PARTITION_TABLE_CUSTOM_FILENAME="partitions.csv"
CONFIG_FREERTOS_HZ=1000
CONFIG_BT_ENABLED=y
CONFIG_BT_CONTROLLER_DISABLED=y
CONFIG_BT_BLUEDROID_ENABLED=n
CONFIG_BT_NIMBLE_ENABLED=y
CONFIG_BT_NIMBLE_TRANSPORT_UART=n
CONFIG_SPIRAM=y
CONFIG_SPIRAM_SPEED_200M=y
CONFIG_SPIRAM_XIP_FROM_PSRAM=y
CONFIG_SPIRAM_MALLOC_ALWAYSINTERNAL=4096
CONFIG_SPIRAM_MALLOC_RESERVE_INTERNAL=65536
CONFIG_MBEDTLS_EXTERNAL_MEM_ALLOC=y
CONFIG_ESP_MAIN_TASK_STACK_SIZE=8192
CONFIG_LWIP_LOCAL_HOSTNAME="ephoto"
CONFIG_ESP_WIFI_REMOTE_LIBRARY_HOSTED=y
CONFIG_ESP_HOSTED_ENABLE_BT_NIMBLE=y
CONFIG_ESP_HOSTED_NIMBLE_HCI_VHCI=y
CONFIG_LOG_DEFAULT_LEVEL_INFO=y
CONFIG_BOOTLOADER_COMPILER_OPTIMIZATION_SIZE=y
CONFIG_BOOTLOADER_APP_ROLLBACK_ENABLE=y
CONFIG_COMPILER_OPTIMIZATION_PERF=y
CONFIG_HTTPD_MAX_REQ_HDR_LEN=2048
CONFIG_HTTPD_MAX_URI_LEN=256
CONFIG_LWIP_MAX_SOCKETS=16
CONFIG_LWIP_TCP_SND_BUF_DEFAULT=5760
CONFIG_LWIP_TCP_WND_DEFAULT=5760
CONFIG_LWIP_TCP_RECVMBOX_SIZE=6
CONFIG_LWIP_TCP_ACCEPTMBOX_SIZE=6
CONFIG_ESP_HOSTED_SDIO_TX_Q_SIZE=12
CONFIG_ESP_HOSTED_SDIO_RX_Q_SIZE=12
# CONFIG_ESP_HOSTED_SDIO_OPTIMIZATION_RX_STREAMING_MODE is not set
# CONFIG_ESP_HOSTED_MEM_MONITOR is not set
CONFIG_ESP_HOSTED_MAX_SIMULTANEOUS_SYNC_RPC_REQUESTS=3
CONFIG_ESP_HOSTED_MAX_SIMULTANEOUS_ASYNC_RPC_REQUESTS=3
# CONFIG_ESP_HOSTED_CLI_ENABLED is not set
CONFIG_MBEDTLS_SSL_IN_CONTENT_LEN=4096
CONFIG_MBEDTLS_SSL_OUT_CONTENT_LEN=2048
CONFIG_LV_BUILD_EXAMPLES=n
CONFIG_LV_BUILD_DEMOS=n
CONFIG_LV_FONT_SOURCE_HAN_SANS_SC_16_CJK=y
CONFIG_MBEDTLS_CERTIFICATE_BUNDLE=y
CONFIG_MBEDTLS_CERTIFICATE_BUNDLE_DEFAULT_FULL=y
CONFIG_FATFS_LFN_HEAP=y
CONFIG_FATFS_MAX_LFN=255
CONFIG_FATFS_API_ENCODING_UTF_8=y
CONFIG_FATFS_CODEPAGE_936=y
CONFIG_JD_SZBUF=4096
CONFIG_JD_FORMAT=1
# CONFIG_JD_FORMAT_RGB888 is not set
CONFIG_JD_FORMAT_RGB565=y
CONFIG_JD_USE_SCALE=y
CONFIG_JD_FASTDECODE=2
# CONFIG_JD_FASTDECODE_BASIC is not set
# CONFIG_JD_FASTDECODE_32BIT is not set
CONFIG_JD_FASTDECODE_TABLE=y
```

## sdkconfig.defaults.c5
```kconfig
CONFIG_ESP_HOSTED_CP_TARGET_ESP32C5=y
# CONFIG_ESP_HOSTED_CP_TARGET_ESP32C6 is not set
CONFIG_ESP_HOSTED_IDF_SLAVE_TARGET="esp32c5"
# CONFIG_SLAVE_IDF_TARGET_ESP32C6 is not set
CONFIG_SLAVE_IDF_TARGET_ESP32C5=y
```

## sdkconfig.defaults.c6
```kconfig
CONFIG_ESP_HOSTED_CP_TARGET_ESP32C6=y
# CONFIG_ESP_HOSTED_CP_TARGET_ESP32C5 is not set
CONFIG_ESP_HOSTED_IDF_SLAVE_TARGET="esp32c6"
CONFIG_SLAVE_IDF_TARGET_ESP32C6=y
# CONFIG_SLAVE_IDF_TARGET_ESP32C5 is not set
```
